## conf/distro/autot-distro.conf
```bitbake
# Distro configuration

include conf/distro/poky.conf

# change information in /etc/os-release
DISTRO_NAME ?= "Autot OS Poky-based"
DISTRO_VERSION ?= "0.1"

# use systemd instead of sysV in the distro
DISTRO_FEATURES:append = " usrmerge"
DISTRO_FEATURES:append = " systemd"
VIRTUAL-RUNTIME_init_manager = "systemd"
DISTRO_FEATURES_BACKFILL_CONSIDERED += "sysvinit"
#VIRTUAL-RUNTIME_initscripts = "systemd-compat-units"
VIRTUAL-RUNTIME_initscripts = ""
```

## conf/machine/autot-raspberrypi2.conf
```bitbake
#inherit sdcard_image-rpi
require conf/machine/raspberrypi2.conf

# Ensure no bootloader is specified for Raspberry Pi 2B
#RPI_USE_U_BOOT="0"

#SDIMG_KERNELIMAGE ?= kernel7.img
#SDIMG_KERNELIMAGE = kernel7.img
#SDIMG_KERNELIMAGE:raspberrypi2 = kernel7.img

# didn't find why IMAGE_BOOT_FILES is not expanded
# and if assiging SDIMG_KERNELIMAGE or inherit sdcard_image-rpi, IMAGE_BOOT_FILES becomes empty


KERNEL_DEVICETREE := "${@d.get('KERNEL_DEVICETREE', '').replace('broadcom/', '')}"
SDIMG_KERNELIMAGE ?= "kernel7.img"
# need to have the qutation mark on the value
```

## conf/machine/autot-raspberrypi5.conf
```bitbake
require conf/machine/raspberrypi5.conf

#KERNEL_DEVICETREE += " 
#KERNEL_DEVICETREE:append = " \
#        overlays/uart0-pi5.dtbo \
#        overlays/uart1-pi5.dtbo \
#        overlays/uart2-pi5.dtbo \
#        overlays/uart3-pi5.dtbo \
#        overlays/uart4-pi5.dtbo \
#"

RPI_KERNEL_DEVICETREE_OVERLAYS += " \
        overlays/uart0-pi5.dtbo \
        overlays/uart1-pi5.dtbo \
        overlays/uart2-pi5.dtbo \
        overlays/uart3-pi5.dtbo \
        overlays/uart4-pi5.dtbo \
"
```

## conf/templates/conf/bblayers.conf.sample
```bitbake
# POKY_BBLAYERS_CONF_VERSION is increased each time build/conf/bblayers.conf
# changes incompatibly
POKY_BBLAYERS_CONF_VERSION = "2"

BBPATH = "${TOPDIR}"
BBFILES ?= ""

BBLAYERS ?= " \
  /home/crane/yocto-pi/sources/poky/meta \
  /home/crane/yocto-pi/sources/poky/meta-poky \
  /home/crane/yocto-pi/sources/poky/meta-yocto-bsp \
  /home/crane/yocto-pi/sources/meta-raspberrypi \
  /home/crane/yocto-pi/sources/meta-autot \
  "
```
